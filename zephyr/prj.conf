## CMakeLists.txt
```
#
# Copyright (c) 2022 Nordic Semiconductor ASA
#
# SPDX-License-Identifier: LicenseRef-Nordic-5-Clause
#

if(CONFIG_WPA_SUPP)

zephyr_library()

set(HOSTAP_BASE ${CMAKE_CURRENT_SOURCE_DIR}/../)
set(WPA_SUPPLICANT_BASE ${HOSTAP_BASE}/wpa_supplicant)
set(COMMON_SRC_BASE ${HOSTAP_BASE}/src)

set(CMAKE_EXE_LINKER_FLAGS "--specs=nosys.specs -lnosys")
set(CMAKE_C_FLAGS "${CMAKE_C_FLAGS} -DMISSING_SYSCALL_NAMES")

zephyr_compile_definitions(
	CONFIG_ZEPHYR
)

zephyr_include_directories(
	${CMAKE_CURRENT_SOURCE_DIR}/src
	${HOSTAP_BASE}/
	${WPA_SUPPLICANT_BASE}/
	${COMMON_SRC_BASE}/
	${ZEPHYR_BASE}/include
	${ZEPHYR_BASE}/include/net
)

zephyr_library_compile_definitions(
	TLS_DEFAULT_CIPHERS=\""DEFAULT:!EXP:!LOW"\"
	CONFIG_SHA256
	CONFIG_SME
	CONFIG_NO_CONFIG_WRITE
	CONFIG_NO_CONFIG_BLOBS
	CONFIG_WPA_S_ZEPHYR_L2_WIFI_MGMT
	#CONFIG_NO_STDOUT_DEBUG
	CONFIG_CTRL_IFACE
	CONFIG_CTRL_IFACE_UDP
	CONFIG_NO_RANDOM_POOL
	)

zephyr_library_include_directories(
	${CMAKE_CURRENT_SOURCE_DIR}/src
	${HOSTAP_BASE}/
	${COMMON_SRC_BASE}/utils
	${COMMON_SRC_BASE}/drivers
	${HOSTAP_BASE}/src
	${ZEPHYR_BASE}/include
	${ZEPHYR_BASE}/include/net
)

zephyr_library_sources(
	${COMMON_SRC_BASE}/common/wpa_common.c
	${COMMON_SRC_BASE}/common/ieee802_11_common.c
	${COMMON_SRC_BASE}/common/hw_features_common.c
	${COMMON_SRC_BASE}/common/wpa_ctrl.c
	${COMMON_SRC_BASE}/common/cli.c

	${COMMON_SRC_BASE}/drivers/driver_common.c
	${COMMON_SRC_BASE}/drivers/drivers.c
	${COMMON_SRC_BASE}/l2_packet/l2_packet_zephyr.c
	${COMMON_SRC_BASE}/drivers/driver_zephyr.c
	${COMMON_SRC_BASE}/utils/base64.c
	${COMMON_SRC_BASE}/utils/common.c
	${COMMON_SRC_BASE}/utils/wpabuf.c
	${COMMON_SRC_BASE}/utils/bitfield.c
	${COMMON_SRC_BASE}/utils/eloop.c
	${COMMON_SRC_BASE}/utils/os_zephyr.c
	${COMMON_SRC_BASE}/utils/radiotap.c
	#${COMMON_SRC_BASE}/utils/edit_simple.c
	${WPA_SUPPLICANT_BASE}/config.c
	${WPA_SUPPLICANT_BASE}/notify.c
	${WPA_SUPPLICANT_BASE}/bss.c
	${WPA_SUPPLICANT_BASE}/eap_register.c
	${WPA_SUPPLICANT_BASE}/op_classes.c
	${WPA_SUPPLICANT_BASE}/rrm.c
	${WPA_SUPPLICANT_BASE}/wmm_ac.c
	${WPA_SUPPLICANT_BASE}/config_none.c
	${WPA_SUPPLICANT_BASE}/sme.c
	${WPA_SUPPLICANT_BASE}/wpa_supplicant.c
	${WPA_SUPPLICANT_BASE}/events.c
	${WPA_SUPPLICANT_BASE}/bssid_ignore.c
	${WPA_SUPPLICANT_BASE}/wpas_glue.c
	${WPA_SUPPLICANT_BASE}/scan.c
	${WPA_SUPPLICANT_BASE}/robust_av.c
	${WPA_SUPPLICANT_BASE}/ctrl_iface.c
	${WPA_SUPPLICANT_BASE}/ctrl_iface_udp.c
	${WPA_SUPPLICANT_BASE}/wpa_cli.c	
	# Zephyr main
	src/supp_main.c
	src/utils/wpa_debug.c
	src/zephyr_supp_api.c
)

zephyr_library_sources_ifdef(CONFIG_WPA_CLI
	src/wpa_cli.c
)

zephyr_library_sources_ifdef(CONFIG_WPA_SUPP_AP
	${WPA_SUPPLICANT_BASE}/ap.c
	${COMMON_SRC_BASE}/ap/ap_config.c
	${COMMON_SRC_BASE}/ap/ap_drv_ops.c
	${COMMON_SRC_BASE}/ap/ap_list.c
	${COMMON_SRC_BASE}/ap/ap_mlme.c
	${COMMON_SRC_BASE}/ap/authsrv.c
	${COMMON_SRC_BASE}/ap/beacon.c
	${COMMON_SRC_BASE}/ap/bss_load.c
	${COMMON_SRC_BASE}/ap/dfs.c
	${COMMON_SRC_BASE}/ap/drv_callbacks.c
	${COMMON_SRC_BASE}/ap/eap_user_db.c
	${COMMON_SRC_BASE}/ap/hostapd.c
	${COMMON_SRC_BASE}/ap/hw_features.c
	${COMMON_SRC_BASE}/ap/ieee802_11_auth.c
	${COMMON_SRC_BASE}/ap/ieee802_11.c
	${COMMON_SRC_BASE}/ap/ieee802_11_he.c
	${COMMON_SRC_BASE}/ap/ieee802_11_ht.c
	${COMMON_SRC_BASE}/ap/ieee802_11_shared.c
	${COMMON_SRC_BASE}/ap/ieee802_11_vht.c
	${COMMON_SRC_BASE}/ap/ieee802_1x.c
	${COMMON_SRC_BASE}/ap/neighbor_db.c
	${COMMON_SRC_BASE}/ap/p2p_hostapd.c
	${COMMON_SRC_BASE}/ap/pmksa_cache_auth.c
	${COMMON_SRC_BASE}/ap/preauth_auth.c
	${COMMON_SRC_BASE}/ap/rrm.c
	${COMMON_SRC_BASE}/ap/sta_info.c
	${COMMON_SRC_BASE}/ap/tkip_countermeasures.c
	${COMMON_SRC_BASE}/ap/utils.c
	${COMMON_SRC_BASE}/ap/wmm.c

	${COMMON_SRC_BASE}/ap/wpa_auth.c
	${COMMON_SRC_BASE}/ap/wpa_auth_ie.c
	${COMMON_SRC_BASE}/ap/wpa_auth_ft.c
	${COMMON_SRC_BASE}/ap/wpa_auth_glue.c

	${COMMON_SRC_BASE}/eap_common/eap_common.c
	${COMMON_SRC_BASE}/eap_server/eap_server.c
	${COMMON_SRC_BASE}/eap_server/eap_server_identity.c
	${COMMON_SRC_BASE}/eap_server/eap_server_methods.c
	${COMMON_SRC_BASE}/eapol_auth/eapol_auth_sm.c
)

zephyr_library_compile_definitions_ifdef(CONFIG_WPA_SUPP_AP
	CONFIG_AP
	CONFIG_NO_RADIUS
	CONFIG_NO_VLAN
	CONFIG_NO_ACCOUNTING
	CONFIG_NEED_AP_MLME
	CONFIG_IEEE80211AX
	CONFIG_EAP_SERVER
	CONFIG_EAP_SERVER_IDENTITY
)


zephyr_library_sources_ifndef(CONFIG_WPA_SUPP_CRYPTO
	${COMMON_SRC_BASE}/crypto/crypto_none.c
)

zephyr_library_compile_definitions_ifndef(CONFIG_WPA_SUPP_CRYPTO
	CONFIG_NO_WPA
	CONFIG_CRYPTO_INTERNAL
)

zephyr_library_compile_definitions_ifdef(CONFIG_WPA_SUPP_CRYPTO
	CONFIG_WEP
)

zephyr_library_sources_ifdef(CONFIG_WPA_SUPP_CRYPTO
	${COMMON_SRC_BASE}/common/wpa_common.c
	${COMMON_SRC_BASE}/rsn_supp/wpa.c
	${COMMON_SRC_BASE}/rsn_supp/preauth.c
	${COMMON_SRC_BASE}/rsn_supp/pmksa_cache.c
	${COMMON_SRC_BASE}/rsn_supp/wpa_ie.c

	${COMMON_SRC_BASE}/crypto/crypto_mbedtls-bignum.c
	${COMMON_SRC_BASE}/crypto/crypto_mbedtls-ec.c
	${COMMON_SRC_BASE}/crypto/crypto_mbedtls.c
	${COMMON_SRC_BASE}/crypto/tls_mbedtls.c
	${COMMON_SRC_BASE}/crypto/aes-wrap.c
	${COMMON_SRC_BASE}/crypto/aes-unwrap.c
	${COMMON_SRC_BASE}/crypto/rc4.c
	#${COMMON_SRC_BASE}/crypto/random.c
	${COMMON_SRC_BASE}/crypto/sha1-prf.c
	${COMMON_SRC_BASE}/crypto/sha256-prf.c
	${COMMON_SRC_BASE}/crypto/sha256-prf.c
	${COMMON_SRC_BASE}/crypto/sha384-prf.c
)


zephyr_library_sources_ifdef(CONFIG_WPA_SUPP_WPA3
	${COMMON_SRC_BASE}/common/sae.c
	${COMMON_SRC_BASE}/common/dragonfly.c

	${COMMON_SRC_BASE}/crypto/dh_groups.c
	${COMMON_SRC_BASE}/crypto/sha256-kdf.c
)

zephyr_library_compile_definitions_ifdef(CONFIG_WPA_SUPP_WPA3
	CONFIG_SAE
	CONFIG_ECC
)

zephyr_library_include_directories_ifdef(CONFIG_WPA_SUPP_CRYPTO
	${CMAKE_SOURCE_DIR}
)

zephyr_library_sources_ifdef(CONFIG_WPA_SUPP_P2P
	${WPA_SUPPLICANT_BASE}/p2p_supplicant.c
	${WPA_SUPPLICANT_BASE}/p2p_supplicant_sd.c
	${COMMON_SRC_BASE}/p2p/p2p.c
	${COMMON_SRC_BASE}/p2p/p2p_utils.c
	${COMMON_SRC_BASE}/p2p/p2p_parse.c
	${COMMON_SRC_BASE}/p2p/p2p_build.c
	${COMMON_SRC_BASE}/p2p/p2p_go_neg.c
	${COMMON_SRC_BASE}/p2p/p2p_sd.c
	${COMMON_SRC_BASE}/p2p/p2p_pd.c
	${COMMON_SRC_BASE}/p2p/p2p_invitation.c
	${COMMON_SRC_BASE}/p2p/p2p_dev_disc.c
	${COMMON_SRC_BASE}/p2p/p2p_group.c
	${COMMON_SRC_BASE}/ap/p2p_hostapd.c
	${COMMON_SRC_BASE}/common/gas.c
	${WPA_SUPPLICANT_BASE}/gas_query.c
	${WPA_SUPPLICANT_BASE}/offchannel.c
)
zephyr_library_sources_ifdef(CONFIG_WPA_SUPP_WPS
	${WPA_SUPPLICANT_BASE}/wps_supplicant.c
	${COMMON_SRC_BASE}/utils/uuid.c
	${COMMON_SRC_BASE}/eap_peer/eap_wsc.c
	${COMMON_SRC_BASE}/eap_common/eap_wsc_common.c
	${COMMON_SRC_BASE}/wps/wps.c
	${COMMON_SRC_BASE}/ap/wps_hostapd.c
	${COMMON_SRC_BASE}/wps/wps_common.c
	${COMMON_SRC_BASE}/wps/wps_attr_parse.c
	${COMMON_SRC_BASE}/wps/wps_attr_build.c
	${COMMON_SRC_BASE}/wps/wps_attr_process.c
	${COMMON_SRC_BASE}/wps/wps_dev_attr.c
	${COMMON_SRC_BASE}/wps/wps_enrollee.c
	${COMMON_SRC_BASE}/wps/wps_registrar.c
	${COMMON_SRC_BASE}/eapol_supp/eapol_supp_sm.c
	${COMMON_SRC_BASE}/eap_peer/eap.c
	${COMMON_SRC_BASE}/eap_peer/eap_methods.c
	${COMMON_SRC_BASE}/eap_common/eap_common.c
	${COMMON_SRC_BASE}/crypto/dh_groups.c
	${COMMON_SRC_BASE}/crypto/dh_group5.c
)

zephyr_library_compile_definitions_ifdef(CONFIG_WPA_SUPP_P2P
	CONFIG_P2P
	CONFIG_GAS
	CONFIG_OFFCHANNEL
)

zephyr_library_compile_definitions_ifdef(CONFIG_WPA_SUPP_WPS
	CONFIG_WPS
	CONFIG_EAP_WSC
	CONFIG_IEEE8021X_EAPOL
)

zephyr_library_sources_ifdef(CONFIG_WPA_SUPP_CRYPTO_ENTERPRISE
	${COMMON_SRC_BASE}/eap_peer/eap_tls.c
	${COMMON_SRC_BASE}/eap_peer/eap_tls_common.c

	${COMMON_SRC_BASE}/eapol_supp/eapol_supp_sm.c
	${COMMON_SRC_BASE}/eap_peer/eap.c
	${COMMON_SRC_BASE}/eap_peer/eap_methods.c
	${COMMON_SRC_BASE}/eap_common/eap_common.c

	${COMMON_SRC_BASE}/eap_peer/eap_peap.c
	${COMMON_SRC_BASE}/eap_common/eap_peap_common.c
	${COMMON_SRC_BASE}/eap_peer/eap_ttls.c
	${COMMON_SRC_BASE}/eap_peer/eap_md5.c
	${COMMON_SRC_BASE}/eap_peer/eap_mschapv2.c
	${COMMON_SRC_BASE}/eap_common/chap.c
	${COMMON_SRC_BASE}/eap_peer/mschapv2.c
	${COMMON_SRC_BASE}/eap_peer/eap_leap.c

	${COMMON_SRC_BASE}/eap_peer/eap_psk.c
	${COMMON_SRC_BASE}/eap_common/eap_psk_common.c

	${COMMON_SRC_BASE}/eap_peer/eap_fast.c
	${COMMON_SRC_BASE}/eap_peer/eap_fast_pac.c
	${COMMON_SRC_BASE}/eap_common/eap_fast_common.c

	${COMMON_SRC_BASE}/eap_peer/eap_pax.c
	${COMMON_SRC_BASE}/eap_common/eap_pax_common.c

	${COMMON_SRC_BASE}/eap_peer/eap_sake.c
	${COMMON_SRC_BASE}/eap_common/eap_sake_common.c

	${COMMON_SRC_BASE}/eap_peer/eap_gpsk.c
	${COMMON_SRC_BASE}/eap_common/eap_gpsk_common.c

	${COMMON_SRC_BASE}/eap_peer/eap_pwd.c
	${COMMON_SRC_BASE}/eap_common/eap_pwd_common.c

	${COMMON_SRC_BASE}/eap_peer/eap_eke.c
	${COMMON_SRC_BASE}/eap_common/eap_eke_common.c

	${COMMON_SRC_BASE}/eap_peer/eap_ikev2.c
	${COMMON_SRC_BASE}/eap_peer/ikev2.c
	${COMMON_SRC_BASE}/eap_common/eap_ikev2_common.c
	${COMMON_SRC_BASE}/eap_common/ikev2_common.c

	# common
	${COMMON_SRC_BASE}/crypto/sha384-tlsprf.c
	${COMMON_SRC_BASE}/crypto/sha256-tlsprf.c
	${COMMON_SRC_BASE}/crypto/sha1-tlsprf.c
	${COMMON_SRC_BASE}/crypto/sha1-tprf.c
	${COMMON_SRC_BASE}/crypto/ms_funcs.c
	${COMMON_SRC_BASE}/crypto/aes-eax.c
	# MD4 removed from MbedTLS
	${COMMON_SRC_BASE}/crypto/md4-internal
	${COMMON_SRC_BASE}/crypto/aes-encblock.c

)

zephyr_library_compile_definitions_ifdef(CONFIG_WPA_SUPP_CRYPTO_ENTERPRISE
	CONFIG_EAP_TLS
	CONFIG_IEEE8021X_EAPOL
	CONFIG_EAP_PEAP
	CONFIG_EAP_TTLS
	CONFIG_EAP_MD5
	CONFIG_EAP_MSCHAPv2
	CONFIG_EAP_LEAP
	CONFIG_EAP_PSK
	CONFIG_EAP_FAST
	CONFIG_EAP_PAX
	CONFIG_EAP_SAKE
	CONFIG_EAP_GPSK
	CONFIG_EAP_PWD
	CONFIG_EAP_EKE
	CONFIG_EAP_IKEv2
)
endif()
```

## Kconfig
```
# Nordic WiFi driver for nRF52840 and nRF5340
#
# Copyright (c) 2022 Nordic Semiconductor
#
# SPDX-License-Identifier: LicenseRef-Nordic-5-Clause
#

config WPA_SUPP
    bool "WPA WPA_SUPP"
    depends on  NET_SOCKETS
    depends on  NET_SOCKETS_POSIX_NAMES || POSIX_API
    select NET_SOCKETS_PACKET
    select NET_MGMT
    select NET_MGMT_EVENT
    select NET_MGMT_EVENT_INFO
    help
      WPA WPA_SUPP

config WPA_SUPP_THREAD_STACK_SIZE
    int "Stack size for wpa_supplicant thread"
    default 8192

config WEP
    bool "WEP (Legacy crypto) support"

config WPA_SUPP_CRYPTO
    bool "Crypto support for WiFi"
    select WEP
    default y

config WPA_SUPP_CRYPTO_ENTERPRISE
    bool "Enterprise Crypto support for WiFi"

config WPA_SUPP_WPA3
    bool "WPA3 support"
    select WPA_SUPP_CRYPTO
    default y

config WPA_SUPP_AP
    bool "AP mode support"
    select WPA_SUPP_CRYPTO

config WPA_SUPP_WPS
    bool "WPS support"

config WPA_SUPP_P2P
    bool "P2P mode support"
    select WPA_SUPP_AP
    select WPA_SUPP_WPS

config WPA_CLI
    bool "CLI support for wpa_supplicant"
    default n

module = WPA_SUPP
module-str = WPA supplicant
source "subsys/logging/Kconfig.template.log_config"

config WPA_SUPP_DEBUG_LEVEL
    int "Min compiled-in debug message level for WPA supplicant"
    default 0 if WPA_SUPP_LOG_LEVEL_DBG # MSG_EXCESSIVE
    default 3 if WPA_SUPP_LOG_LEVEL_INF # MSG_INFO
    default 4 if WPA_SUPP_LOG_LEVEL_WRN # MSG_WARNING
    default 5 if WPA_SUPP_LOG_LEVEL_ERR # MSG_ERROR
    default 6
    help
      Minimum priority level of a debug message emitted by WPA supplicant that
      is compiled-in the firmware. See wpa_debug.h file of the supplicant for
      available levels and functions for emitting the messages. Note that
      runtime filtering can also be configured in addition to the compile-time
      filtering.
```

## west.yml
```
# Copyright (c) 2021 Nordic Semiconductor ASA
# SPDX-License-Identifier: Apache-2.0

manifest:
  self:
    path: wpa_supplicant_zephyr

  remotes:
    - name: zephyrproject-rtos
      url-base: https://github.com/zephyrproject-rtos

  projects:
    - name: zephyr
      remote: zephyrproject-rtos
      revision: main
      import: true
```

## prj.conf
```kconfig
CONFIG_EARLY_CONSOLE=y

# Generic networking options
CONFIG_NETWORKING=y
CONFIG_NET_IPV4=y
CONFIG_NET_LOOPBACK=y
#CONFIG_NET_DRIVERS=y
# Need full fledged support
CONFIG_NEWLIB_LIBC=y
CONFIG_NET_IPV6=y
CONFIG_NET_UDP=y

CONFIG_NET_SOCKETS=y
CONFIG_NET_SOCKETS_POSIX_NAMES=y
CONFIG_NET_SOCKETS_POLL_MAX=4
CONFIG_NET_SOCKETS_PACKET=y

CONFIG_COAP=y
#CONFIG_DEBUG=y

# Kernel options
CONFIG_ENTROPY_GENERATOR=y

# Logging
CONFIG_PRINTK=y
CONFIG_NET_LOG=y
CONFIG_SHELL=y
CONFIG_SHELL_GETOPT=y
CONFIG_DEVICE_SHELL=y
CONFIG_POSIX_CLOCK=y
CONFIG_DATE_SHELL=y

# Debugging
CONFIG_STACK_SENTINEL=y
CONFIG_DEBUG_COREDUMP=y
CONFIG_DEBUG_COREDUMP_BACKEND_LOGGING=y

# Network Shell
CONFIG_NET_SHELL=y

# Wi-Fi
# Need to manually disable CONFIG_NET_L2_WIFI_MGMT in subsys/net/l2/Kconfig: 117
# and enable -DCONFIG_WPA_S_ZEPHYR_L2_WIFI_MGMT in CMakelists.txt
CONFIG_NET_L2_WIFI_SHELL=y
CONFIG_NET_MGMT_EVENT_INFO=y

# Security (use SW crypto for now)
CONFIG_CRYPTO=n
# CONFIG_CRYPTO_MBEDTLS_SHIM=y
# CONFIG_MBEDTLS_HEAP_SIZE=2048

CONFIG_NET_CONFIG_SETTINGS=y
CONFIG_NET_CONFIG_NEED_IPV6=y
CONFIG_NET_CONFIG_MY_IPV6_ADDR="2001:db8::2"
CONFIG_NET_CONFIG_PEER_IPV6_ADDR="2001:db8::1"

CONFIG_HEAP_MEM_POOL_SIZE=2048
CONFIG_MAIN_STACK_SIZE=4096
```

## src/main.h
```c
/*
 * Copyright (c) 2022 Nordic Semiconductor ASA
 *
 * SPDX-License-Identifier: LicenseRef-Nordic-5-Clause
 */

#ifndef __MAIN_H__
#define __MAIN_H__
extern void start_wpa_supplicant_thread(void);
#endif /* __MAIN_H__ */
```

## src/supp_main.c
```c
/*
 * Copyright (c) 2022 Nordic Semiconductor ASA
 *
 * SPDX-License-Identifier: LicenseRef-Nordic-5-Clause
 */

/*
 * WPA Supplicant / main() function for Zephyr OS
 * Copyright (c) 2003-2013, Jouni Malinen <j@w1.fi>
 *
 * This software may be distributed under the terms of the BSD license.
 * See README for more details.
 */

#include <logging/log.h>
LOG_MODULE_REGISTER(wpa_supplicant, LOG_LEVEL_DBG);

#include "main.h"

#include "includes.h"
#include "common.h"
#include "wpa_supplicant_i.h"
#include "driver_i.h"
#include "fst/fst.h"
#include "includes.h"
#include "p2p_supplicant.h"
#include "wpa_supplicant_i.h"
#include "wifi_mgmt.h"

#define MY_STACK_SIZE 8192
#define MY_PRIORITY 0

struct wpa_supplicant *wpa_s_0;

extern void start_wpa_supplicant(void);
static struct k_sem quit_lock;

K_THREAD_DEFINE(wpa_s_tid, MY_STACK_SIZE, start_wpa_supplicant, NULL, NULL,
		NULL, MY_PRIORITY, 0, 0);

#ifdef CONFIG_MATCH_IFACE
static int wpa_supplicant_init_match(struct wpa_global *global)
{
	/*
	 * The assumption is that the first driver is the primary driver and
	 * will handle the arrival / departure of interfaces.
	 */
	if (wpa_drivers[0]->global_init && !global->drv_priv[0]) {
		global->drv_priv[0] = wpa_drivers[0]->global_init(global);
		if (!global->drv_priv[0]) {
			wpa_printf(MSG_ERROR,
				   "Failed to initialize driver '%s'",
				   wpa_drivers[0]->name);
			return -1;
		}
	}

	return 0;
}
#endif /* CONFIG_MATCH_IFACE */

#include "config.h"

static void iface_cb(struct net_if *iface, void *user_data)
{
	struct wpa_interface *ifaces = user_data;
	struct net_linkaddr *link_addr = NULL;
	int ifindex;
	char own_addr[6];
	char *ifname;

	ifindex = net_if_get_by_iface(iface);
	link_addr = &iface->if_dev->link_addr;
	os_memcpy(own_addr, link_addr->addr, link_addr->len);
	ifname = os_strdup(iface->if_dev->dev->name);

	wpa_printf(
		MSG_INFO,
		"iface_cb: iface %s ifindex %d %02x:%02x:%02x:%02x:%02x:%02x",
		ifname, ifindex, own_addr[0], own_addr[1], own_addr[2],
		own_addr[3], own_addr[4], own_addr[5]);

    /* TODO : make this user configurable*/
    ifaces[0].ifname = "wlan1";
}

void start_wpa_supplicant_thread(void)
{
	k_sem_init(&quit_lock, 0, K_SEM_MAX_LIMIT);

	k_thread_name_set(wpa_s_tid, "wpa_supplicant");
	k_thread_start(wpa_s_tid);
	k_sem_take(&quit_lock, K_FOREVER);
}

void start_wpa_supplicant(void)
{
	int i;
	struct wpa_interface *ifaces, *iface;
	int iface_count, exitcode = -1;
	struct wpa_params params;
	struct wpa_global *global;

	os_memset(&params, 0, sizeof(params));
	params.wpa_debug_level = str_to_debug_level(CONFIG_WPA_SUPP_DEBUG_LEVEL);

	wpa_printf(MSG_INFO, "%s: %d Starting wpa_supplicant thread with debug level: %d\n",
		  __func__, __LINE__, params.wpa_debug_level);

	iface = ifaces = os_zalloc(sizeof(struct wpa_interface));
	if (ifaces == NULL) {
		return;
	}
	iface_count = 1;

	exitcode = 0;
	global = wpa_supplicant_init(&params);
	if (global == NULL) {
		wpa_printf(MSG_ERROR, "Failed to initialize wpa_supplicant");
		exitcode = -1;
		goto out;
	} else {
		wpa_printf(MSG_INFO, "Successfully initialized "
				     "wpa_supplicant");
	}

	if (fst_global_init()) {
		wpa_printf(MSG_ERROR, "Failed to initialize FST");
		exitcode = -1;
		goto out;
	}

#if defined(CONFIG_FST) && defined(CONFIG_CTRL_IFACE)
	if (!fst_global_add_ctrl(fst_ctrl_cli)) {
		wpa_printf(MSG_WARNING, "Failed to add CLI FST ctrl");
	}
#endif

	net_if_foreach(iface_cb, ifaces);

	ifaces[0].ctrl_interface = "test_ctrl";
	params.ctrl_interface = "test_ctrl";
	wpa_printf(MSG_INFO, "Using interface %s\n", ifaces[0].ifname);

	for (i = 0; exitcode == 0 && i < iface_count; i++) {
		struct wpa_supplicant *wpa_s;

		if ((ifaces[i].confname == NULL &&
		     ifaces[i].ctrl_interface == NULL) ||
		    ifaces[i].ifname == NULL) {
			if (iface_count == 1 && (params.ctrl_interface ||
#ifdef CONFIG_MATCH_IFACE
						 params.match_iface_count ||
#endif /* CONFIG_MATCH_IFACE */
						 params.dbus_ctrl_interface))
				break;
			wpa_printf(MSG_INFO,
				   "Failed to initialize interface %d\n", i);
			exitcode = -1;
			break;
		}
		wpa_printf(MSG_INFO, "Initializing interface %d: %s\n", i,
			   ifaces[i].ifname);
		wpa_s = wpa_supplicant_add_iface(global, &ifaces[i], NULL);
		if (wpa_s == NULL) {
			exitcode = -1;
			break;
		}
		wpa_s_0 = wpa_s;
	}

#ifdef CONFIG_MATCH_IFACE
	if (exitcode == 0) {
		exitcode = wpa_supplicant_init_match(global);
	}
#endif /* CONFIG_MATCH_IFACE */

	if (exitcode == 0) {
		exitcode = wpa_supplicant_run(global);
	}

	wpa_supplicant_deinit(global);

	fst_global_deinit();

out:
	os_free(ifaces);
#ifdef CONFIG_MATCH_IFACE
	os_free(params.match_ifaces);
#endif /* CONFIG_MATCH_IFACE */
	os_free(params.pid_file);

	k_sem_give(&quit_lock);
	wpa_printf(MSG_INFO, "wpa_supplicant_main: exitcode %d", exitcode);
	return;
}
```

## src/supp_mgmt.c
```c
/*
 * Copyright (c) 2022 Nordic Semiconductor ASA
 *
 * SPDX-License-Identifier: LicenseRef-Nordic-5-Clause
 */

#include <logging/log.h>
LOG_MODULE_REGISTER(wpa_supplicant_mgmt, LOG_LEVEL_DBG);

#include "main.h"

#include "includes.h"
#include "common.h"
#include "wpa_supplicant/config.h"
#include "wpa_supplicant_i.h"
#include "driver_i.h"
#include "fst/fst.h"
#include "includes.h"
#include "p2p_supplicant.h"
#include "wpa_supplicant_i.h"
#include "wifi_mgmt.h"
#include "supp_mgmt.h"
#include "driver_zephyr.h"

extern struct wpa_supplicant *wpa_s_0;

#define MAX_SSID_LEN 32

static void scan_result_cb(struct net_if *iface, int status,
			   struct wifi_scan_result *entry)
{
	if (!iface) {
		return;
	}

	if (!entry) {
		struct wifi_status scan_status = {
			.status = status,
		};

		net_mgmt_event_notify_with_info(NET_EVENT_SUPP_SCAN_DONE, iface,
						&scan_status,
						sizeof(struct wifi_status));
		return;
	}

	net_mgmt_event_notify_with_info(NET_EVENT_SUPP_SCAN_RESULT, iface,
					entry, sizeof(struct wifi_scan_result));
}

static int wifi_supp_scan(uint32_t mgmt_request, struct net_if *iface,
			  void *data, size_t len)
{
	const struct device *dev = net_if_get_device(iface);
	const struct zep_wpa_supp_dev_ops *nvlsi_dev_ops = dev->api;

	return nvlsi_dev_ops->off_api.disp_scan(dev, scan_result_cb);
}

static int wifi_supp_connect(uint32_t mgmt_request, struct net_if *iface,
			     void *data, size_t len)
{
	struct wifi_connect_req_params *params =
		(struct wifi_connect_req_params *)data;
#ifdef notyet
	const struct device *dev = net_if_get_device(iface);
	const struct img_rpu_dev_ops_zep *nvlsi_dev_ops = dev->api;
#endif /* notyet */
	struct wpa_ssid *ssid = wpa_supplicant_add_network(wpa_s_0);
	bool pmf = true;

	ssid->ssid = os_zalloc(sizeof(u8) * MAX_SSID_LEN);

	memcpy(ssid->ssid, params->ssid, params->ssid_length);
	ssid->ssid_len = params->ssid_length;
	ssid->disabled = 1;
	ssid->key_mgmt = WPA_KEY_MGMT_NONE;

	wpa_s_0->conf->filter_ssids = 1;
	wpa_s_0->conf->ap_scan= 1;

	if (params->psk) {
		// TODO: Extend enum wifi_security_type
		if (params->security == 3) {
			ssid->key_mgmt = WPA_KEY_MGMT_SAE;
			str_clear_free(ssid->sae_password);
			ssid->sae_password = dup_binstr(params->psk, params->psk_length);
			if (ssid->sae_password == NULL) {
				printk("%s:Failed to copy sae_password\n", __func__);
				return -1;
			}
		} else {
			if (params->security == 2)
				ssid->key_mgmt = WPA_KEY_MGMT_PSK_SHA256;
			else
				ssid->key_mgmt = WPA_KEY_MGMT_PSK;
			str_clear_free(ssid->passphrase);
			ssid->passphrase = dup_binstr(params->psk, params->psk_length);
			if (ssid->passphrase == NULL) {
				printk("%s:Failed to copy passphrase\n", __func__);
				return -1;
			}
		}

		wpa_config_update_psk(ssid);
	}

	if (pmf)
		ssid->ieee80211w = 1;

	wpa_supplicant_enable_network(wpa_s_0, ssid);

	return 0;
}

static int wifi_supp_ap_enable(uint32_t mgmt_request, struct net_if *iface,
			       void *data, size_t len)
{
	struct wifi_connect_req_params *params =
		(struct wifi_connect_req_params *)data;
	struct wpa_supplicant *wpa_s = wpa_s_0;
	struct wpa_ssid *ssid = wpa_supplicant_add_network(wpa_s_0);

	ssid->ssid = os_zalloc(sizeof(u8) * MAX_SSID_LEN);

	memcpy(ssid->ssid, params->ssid, params->ssid_length);
	ssid->ssid_len = params->ssid_length;
	ssid->disabled = 1;
	ssid->mode = 2;
	// TODO: Take this from shell
	ssid->frequency = 2412;
	// TODO: 11g for now
	ssid->ht = 0;
	ssid->key_mgmt = WPA_KEY_MGMT_NONE;

	wpa_s->conf->filter_ssids = 1;
	// Start AP immediately
	wpa_s->conf->ap_scan= 2;

	wpa_supplicant_enable_network(wpa_s, ssid);
}

static int wifi_supp_ap_disable(uint32_t mgmt_request, struct net_if *iface,
			       void *data, size_t len)
{
	struct wifi_connect_req_params *params =
		(struct wifi_connect_req_params *)data;
}

NET_MGMT_REGISTER_REQUEST_HANDLER(NET_REQUEST_SUPP_SCAN, wifi_supp_scan);
NET_MGMT_REGISTER_REQUEST_HANDLER(NET_REQUEST_SUPP_CONNECT, wifi_supp_connect);
NET_MGMT_REGISTER_REQUEST_HANDLER(NET_REQUEST_SUPP_AP_ENABLE, wifi_supp_ap_enable);
NET_MGMT_REGISTER_REQUEST_HANDLER(NET_REQUEST_SUPP_AP_DISABLE, wifi_supp_ap_disable);
```

## src/supp_mgmt.h
```c
/*
 * Copyright (c) 2022 Nordic Semiconductor ASA
 *
 * SPDX-License-Identifier: LicenseRef-Nordic-5-Clause
 */

#ifndef __SUPP_MGMT_H__
#define __SUPP_MGMT_H__

/* Management part definitions */
#include <net/net_mgmt.h>
#include <net/wifi.h>

#define _NET_SUPP_LAYER NET_MGMT_LAYER_L2
/* TODO: See if this needs to be assigned a different code */
#define _NET_SUPP_CODE 0x157
#define _NET_SUPP_BASE                                                         \
	(NET_MGMT_IFACE_BIT | NET_MGMT_LAYER(_NET_SUPP_LAYER) |                \
	 NET_MGMT_LAYER_CODE(_NET_SUPP_CODE))
#define _NET_SUPP_EVENT (_NET_SUPP_BASE | NET_MGMT_EVENT_BIT)

/* Request a Wi-Fi scan */
#define NET_REQUEST_SUPP_SCAN (_NET_SUPP_BASE | NET_REQUEST_SUPP_CMD_SCAN)

NET_MGMT_DEFINE_REQUEST_HANDLER(NET_REQUEST_SUPP_SCAN);

/* Request a connection to a specified SSID */
#define NET_REQUEST_SUPP_CONNECT (_NET_SUPP_BASE | NET_REQUEST_SUPP_CMD_CONNECT)

NET_MGMT_DEFINE_REQUEST_HANDLER(NET_REQUEST_SUPP_CONNECT);

#ifdef notyet
#define NET_REQUEST_SUPP_DISCONNECT                                            \
	(_NET_SUPP_BASE | NET_REQUEST_SUPP_CMD_DISCONNECT)

NET_MGMT_DEFINE_REQUEST_HANDLER(NET_REQUEST_SUPP_DISCONNECT);
#endif /* notyet */

#define NET_REQUEST_SUPP_AP_ENABLE                                             \
	(_NET_SUPP_BASE | NET_REQUEST_SUPP_CMD_AP_ENABLE)

NET_MGMT_DEFINE_REQUEST_HANDLER(NET_REQUEST_SUPP_AP_ENABLE);

#define NET_REQUEST_SUPP_AP_DISABLE                                            \
	(_NET_SUPP_BASE | NET_REQUEST_SUPP_CMD_AP_DISABLE)

NET_MGMT_DEFINE_REQUEST_HANDLER(NET_REQUEST_SUPP_AP_DISABLE);


/* Scan result event */
#define NET_EVENT_SUPP_SCAN_RESULT                                             \
	(_NET_SUPP_EVENT | NET_EVENT_SUPP_CMD_SCAN_RESULT)

/* Event to indicate that a scan is completed */
#define NET_EVENT_SUPP_SCAN_DONE                                               \
	(_NET_SUPP_EVENT | NET_EVENT_SUPP_CMD_SCAN_DONE)

/* Event to indicate the status of a connection request */
#define NET_EVENT_SUPP_CONNECT_RESULT                                          \
	(_NET_SUPP_EVENT | NET_EVENT_SUPP_CMD_CONNECT_RESULT)

#ifdef notyet
#define NET_EVENT_SUPP_DISCONNECT_RESULT                                       \
	(_NET_SUPP_EVENT | NET_EVENT_SUPP_CMD_DISCONNECT_RESULT)
#endif /* notyet */

/**
 * enum net_request_supp_cmd - Network management API commands for WPA supplicant.
 * @NET_REQUEST_SUPP_CMD_SCAN: Initiate a Wi-Fi scan.
 * @NET_REQUEST_SUPP_CMD_CONNECT: Initiate a Wi-Fi connection to a specified SSID.
 *
 * This enum lists the possible WLAN access categories.
 */
enum net_request_supp_cmd {
	NET_REQUEST_SUPP_CMD_SCAN = 1,
	NET_REQUEST_SUPP_CMD_CONNECT,
#ifdef notyet
	NET_REQUEST_SUPP_CMD_DISCONNECT,
#endif /* notyet */
	NET_REQUEST_SUPP_CMD_AP_ENABLE,
	NET_REQUEST_SUPP_CMD_AP_DISABLE,
};

/**
 * enum net_event_supp_cmd - Network management API events from WPA supplicant.
 * @NET_EVENT_SUPP_CMD_SCAN_RESULT: Scan result event.
 * @NET_EVENT_SUPP_CMD_SCAN_DONE: Event to indicate scan complete.
 * @NET_EVENT_SUPP_CMD_CONNECT_RESULT: Event to indicate status of a connect request.
 *
 * This enum lists the possible WLAN access categories.
 */
enum net_event_supp_cmd {
	NET_EVENT_SUPP_CMD_SCAN_RESULT = 1,
	NET_EVENT_SUPP_CMD_SCAN_DONE,
	NET_EVENT_SUPP_CMD_CONNECT_RESULT,
#ifdef notyet
	NET_EVENT_SUPP_CMD_DISCONNECT_RESULT,
#endif /* notyet */
};

#endif /* __SUPP_MGMT_H__ */
```

## src/supp_shell.c
```c
/*
 * Copyright (c) 2022 Nordic Semiconductor ASA
 *
 * SPDX-License-Identifier: LicenseRef-Nordic-5-Clause
 */

/* @file
 * @brief WPA supplicant shell module
 */

#include <logging/log.h>
LOG_MODULE_REGISTER(net_supp_shell, LOG_LEVEL_INF);

#include <zephyr.h>
#include <stdio.h>
#include <stdlib.h>
#include <shell/shell.h>
#include <sys/printk.h>
#include <init.h>

#include <net/net_if.h>
#include <net/wifi_mgmt.h>
#include <net/net_event.h>
#include "supp_mgmt.h"

#define SUPPLICANT_SHELL_MODULE "wpa_supp"

#define SUPPLICANT_SHELL_MGMT_EVENTS                                           \
	(NET_EVENT_SUPP_SCAN_RESULT | NET_EVENT_SUPP_SCAN_DONE |               \
	 NET_EVENT_SUPP_CONNECT_RESULT)

static struct {
	const struct shell *shell;

	union {
		struct {
			uint8_t connecting : 1;
			uint8_t disconnecting : 1;
			uint8_t _unused : 6;
		};
		uint8_t all;
	};
} context;

static uint32_t scan_result;

static struct net_mgmt_event_callback supplicant_shell_mgmt_cb;

#define print(shell, level, fmt, ...)                                          \
	do {                                                                   \
		if (shell) {                                                   \
			shell_fprintf(shell, level, fmt, ##__VA_ARGS__);       \
		} else {                                                       \
			printk(fmt, ##__VA_ARGS__);                            \
		}                                                              \
	} while (false)

static void handle_supplicant_scan_result(struct net_mgmt_event_callback *cb)
{
	const struct wifi_scan_result *entry =
		(const struct wifi_scan_result *)cb->info;

	scan_result++;

	if (scan_result == 1U) {
		print(context.shell, SHELL_NORMAL,
		      "%-4s | %-32s %-5s | %-4s | %-4s | %-5s\n", "Num", "SSID",
		      "(len)", "Chan", "RSSI", "Sec");
	}

	print(context.shell, SHELL_NORMAL,
	      "%-4d | %-32s %-5u | %-4u | %-4d | %-5s\n", scan_result,
	      entry->ssid, entry->ssid_length, entry->channel, entry->rssi,
	      (entry->security == WIFI_SECURITY_TYPE_PSK ? "WPA/WPA2" :
							   "Open"));
}

static void handle_supplicant_scan_done(struct net_mgmt_event_callback *cb)
{
	const struct wifi_status *status = (const struct wifi_status *)cb->info;

	if (status->status) {
		print(context.shell, SHELL_WARNING,
		      "Scan request failed (%d)\n", status->status);
	} else {
		print(context.shell, SHELL_NORMAL, "Scan request done\n");
	}

	scan_result = 0U;
}

static void handle_supplicant_connect_result(struct net_mgmt_event_callback *cb)
{
	const struct wifi_status *status = (const struct wifi_status *)cb->info;

	if (status->status) {
		print(context.shell, SHELL_WARNING,
		      "Connection request failed (%d)\n", status->status);
	} else {
		print(context.shell, SHELL_NORMAL, "Connected\n");
	}

	context.connecting = false;
}

#ifdef notyet
static void
handle_supplicant_disconnect_result(struct net_mgmt_event_callback *cb)
{
	const struct wifi_status *status = (const struct wifi_status *)cb->info;

	if (context.disconnecting) {
		print(context.shell,
		      status->status ? SHELL_WARNING : SHELL_NORMAL,
		      "Disconnection request %s (%d)\n",
		      status->status ? "failed" : "done", status->status);
		context.disconnecting = false;
	} else {
		print(context.shell, SHELL_NORMAL, "Disconnected\n");
	}
}
#endif /* notyet */

static void supplicant_mgmt_event_handler(struct net_mgmt_event_callback *cb,
					  uint32_t mgmt_event,
					  struct net_if *iface)
{
	switch (mgmt_event) {
	case NET_EVENT_SUPP_SCAN_RESULT:
		handle_supplicant_scan_result(cb);
		break;
	case NET_EVENT_SUPP_SCAN_DONE:
		handle_supplicant_scan_done(cb);
		break;
	case NET_EVENT_SUPP_CONNECT_RESULT:
		handle_supplicant_connect_result(cb);
		break;
#ifdef notyet
	case NET_EVENT_SUPP_DISCONNECT_RESULT:
		handle_supplicant_disconnect_result(cb);
		break;
#endif /* notyet */
	default:
		break;
	}
}

static int __wifi_args_to_params(size_t argc, char *argv[],
				 struct wifi_connect_req_params *params)
{
	char *endptr;
	int idx = 1;

	if (argc < 1) {
		return -EINVAL;
	}

	/* SSID */
	params->ssid = argv[0];
	params->ssid_length = strlen(params->ssid);

	/* Channel (optional) */
	if ((idx < argc) && (strlen(argv[idx]) <= 2)) {
		params->channel = strtol(argv[idx], &endptr, 10);
		if (*endptr != '\0') {
			return -EINVAL;
		}

		if (params->channel == 0U) {
			params->channel = WIFI_CHANNEL_ANY;
		}

		idx++;
	} else {
		params->channel = WIFI_CHANNEL_ANY;
	}

	/* PSK (optional) */
	if (idx < argc) {
		params->psk = argv[idx];
		params->psk_length = strlen(argv[idx]);
		params->security = WIFI_SECURITY_TYPE_PSK;
		idx++;
		if ((idx < argc) && (strlen(argv[idx]) <= 2)) {
				params->security= strtol(argv[idx], &endptr, 10);
		}
	} else {
		params->security = WIFI_SECURITY_TYPE_NONE;
	}

	return 0;
}

static int cmd_supplicant_connect(const struct shell *shell, size_t argc,
				  char *argv[])
{
	struct net_if *iface = net_if_get_default();
	static struct wifi_connect_req_params cnx_params;

	if (__wifi_args_to_params(argc - 1, &argv[1], &cnx_params)) {
		shell_help(shell);
		return -ENOEXEC;
	}

	context.connecting = true;
	context.shell = shell;

	if (net_mgmt(NET_REQUEST_SUPP_CONNECT, iface, &cnx_params,
		     sizeof(struct wifi_connect_req_params))) {
		shell_fprintf(shell, SHELL_WARNING,
			      "Connection request failed\n");
		context.connecting = false;

		return -ENOEXEC;
	} else {
		shell_fprintf(shell, SHELL_NORMAL, "Connection requested\n");
	}

	return 0;
}

#ifdef notyet
static int cmd_supplicant_disconnect(const struct shell *shell, size_t argc,
				     char *argv[])
{
	struct net_if *iface = net_if_get_default();
	int status;

	context.disconnecting = true;
	context.shell = shell;

	status = net_mgmt(NET_REQUEST_SUPP_DISCONNECT, iface, NULL, 0);

	if (status) {
		context.disconnecting = false;

		if (status == -EALREADY) {
			shell_fprintf(shell, SHELL_INFO,
				      "Already disconnected\n");
		} else {
			shell_fprintf(shell, SHELL_WARNING,
				      "Disconnect request failed\n");
			return -ENOEXEC;
		}
	} else {
		shell_fprintf(shell, SHELL_NORMAL, "Disconnect requested\n");
	}

	return 0;
}
#endif /* notyet */

static int cmd_supplicant_scan(const struct shell *shell, size_t argc,
			       char *argv[])
{
	struct net_if *iface = net_if_get_default();

	context.shell = shell;

	/* shell_fprintf(shell, SHELL_WARNING, "Scan request failed\n"); */
	/* return 0; */

	if (net_mgmt(NET_REQUEST_SUPP_SCAN, iface, NULL, 0)) {
		shell_fprintf(shell, SHELL_WARNING, "Scan request failed\n");

		return -ENOEXEC;
	} else {
		shell_fprintf(shell, SHELL_NORMAL, "Scan requested\n");
	}

	return 0;
}

static int cmd_supplicant_ap_enable(const struct shell *shell, size_t argc,
				    char *argv[])
{
	struct net_if *iface = net_if_get_default();
	static struct wifi_connect_req_params cnx_params;

	if (__wifi_args_to_params(argc - 1, &argv[1], &cnx_params)) {
		shell_help(shell);
		return -ENOEXEC;
	}

	context.shell = shell;

	if (net_mgmt(NET_REQUEST_SUPP_AP_ENABLE, iface, &cnx_params,
		     sizeof(struct wifi_connect_req_params))) {
		shell_fprintf(shell, SHELL_WARNING, "AP mode failed\n");
		return -ENOEXEC;
	} else {
		shell_fprintf(shell, SHELL_NORMAL, "AP mode enabled\n");
	}

	return 0;
}

static int cmd_supplicant_ap_disable(const struct shell *shell, size_t argc,
				     char *argv[])
{
	struct net_if *iface = net_if_get_default();

	if (net_mgmt(NET_REQUEST_SUPP_AP_DISABLE, iface, NULL, 0)) {
		shell_fprintf(shell, SHELL_WARNING, "AP mode disable failed\n");

		return -ENOEXEC;
	} else {
		shell_fprintf(shell, SHELL_NORMAL, "AP mode disabled\n");
	}

	return 0;
}

SHELL_STATIC_SUBCMD_SET_CREATE(supplicant_cmd_ap,
			       SHELL_CMD(enable, NULL,
					 "<SSID> <SSID length> [channel] [PSK]",
					 cmd_supplicant_ap_enable),
			       SHELL_CMD(disable, NULL,
					 "Disable Access Point mode",
					 cmd_supplicant_ap_disable),
			       SHELL_SUBCMD_SET_END);


SHELL_STATIC_SUBCMD_SET_CREATE(
	supplicant_commands,
	SHELL_CMD(scan, NULL, "Scan AP", cmd_supplicant_scan),
	SHELL_CMD(connect, NULL,
		  "\"<SSID>\"\n<channel number (optional), "
		  "0 means all>\n"
		  "<PSK (optional: valid only for secured SSIDs)>",
		  cmd_supplicant_connect),
#ifdef notyet
	SHELL_CMD(disconnect, NULL, "Disconnect from AP",
		  cmd_supplicant_disconnect),
#endif /* notyet */
	SHELL_CMD(ap, &supplicant_cmd_ap, "Access Point mode commands", NULL),
	SHELL_SUBCMD_SET_END);

SHELL_CMD_REGISTER(wpa_supp, &supplicant_commands, "WPA supplicant commands",
		   NULL);

static int supplicant_shell_init(const struct device *unused)
{
	ARG_UNUSED(unused);

	context.shell = NULL;
	context.all = 0U;
	scan_result = 0U;

	net_mgmt_init_event_callback(&supplicant_shell_mgmt_cb,
				     supplicant_mgmt_event_handler,
				     SUPPLICANT_SHELL_MGMT_EVENTS);

	net_mgmt_add_event_callback(&supplicant_shell_mgmt_cb);

	return 0;
}

SYS_INIT(supplicant_shell_init, APPLICATION,
	 CONFIG_KERNEL_INIT_PRIORITY_DEFAULT);
```

## src/zephyr_supp_api.c
```c
/**
 * Copyright (c) 2022 Nordic Semiconductor ASA
 *
 * SPDX-License-Identifier: LicenseRef-Nordic-5-Clause
 */

/*
 * WPA Supplicant / main() function for Zephyr OS
 * Copyright (c) 2003-2013, Jouni Malinen <j@w1.fi>
 *
 * This software may be distributed under the terms of the BSD license.
 * See README for more details.
 */

#include <zephyr/logging/log.h>

#include "includes.h"
#include "common.h"
#include "common/defs.h"
#include "wpa_supplicant/config.h"
#include "wpa_supplicant_i.h"
#include "driver_i.h"

#include "zephyr_fmac_main.h"
#include "zephyr_supp_api.h"

int cli_main(int, const char **);
extern struct wpa_global *global;

enum requested_ops {
	CONNECT = 0,
	DISCONNECT
};

#define DEFAULT_CONNECTION_TIMEOUT_S 15

struct wpa_supp_api_ctrl {
	const struct device *dev;
	int requested_op;
	int connection_timeout;
};

struct wpa_supp_api_ctrl wpa_supp_api_ctrl;

static inline struct wpa_supplicant * get_wpa_s_handle(const struct device *dev)
{
	struct wpa_supplicant *wpa_s = wpa_supplicant_get_iface(global, dev->name);
	if (!wpa_s) {
		wpa_printf(MSG_ERROR,
		"%s: Unable to get wpa_s handle for %s\n", __func__, dev->name);
		return NULL;
	}

	return wpa_s;
}

static void supp_shell_connect_status(void *wpa_supp_api_ctrl)
{
	int i = 0, status = 0;
	struct wpa_supplicant *wpa_s;
	struct wpa_supp_api_ctrl *ctrl = ctrl;

	wpa_s = get_wpa_s_handle(ctrl->dev);
	if (!wpa_s) {
		status = 1;
		goto out;
	}

	if (ctrl->requested_op == CONNECT) {
		/* TODO: use a timer for connection timeout*/
		while (wpa_s->wpa_state != WPA_COMPLETED && i++ < ctrl->connection_timeout){
			k_yield();
			k_msleep(1000);
		}

		if (i >= ctrl->connection_timeout){
			if (wpa_s->wpa_state != WPA_COMPLETED){
				zephyr_supp_disconnect(ctrl->dev);
				status = 1;
				goto out;
			}
		}
	}
out:
	if (ctrl->requested_op == CONNECT) {
		wifi_mgmt_raise_connect_result_event(net_if_lookup_by_dev(ctrl->dev), status);
	} else if (ctrl->requested_op == DISCONNECT) {
		/* Disconnect is a synchronous operation i.e., we are already disconnected
		 * we are just using this thread to post net_mgmt event
		 */
		wifi_mgmt_raise_disconnect_result_event(net_if_lookup_by_dev(ctrl->dev), 0);
	}
}

K_THREAD_DEFINE(wpa_supp_api,
				1024,
				supp_shell_connect_status,
                &wpa_supp_api_ctrl,
                NULL,
                NULL,
                0,
                0,
                -1);


int zephyr_supp_scan(const struct device *dev, scan_result_cb_t cb)
{
	const struct wifi_nrf_dev_ops *dev_ops = dev->api;

	return dev_ops->off_api.disp_scan(dev, cb);
}


int zephyr_supp_connect(const struct device *dev,
						struct wifi_connect_req_params *params)
{
	struct wpa_ssid *ssid = NULL;
	bool pmf = true;
	struct wpa_supplicant *wpa_s;

	wpa_s = get_wpa_s_handle(dev);
	if (!wpa_s) {
		return -1;
	}

	ssid = wpa_supplicant_add_network(wpa_s);
	ssid->ssid = os_zalloc(sizeof(u8) * MAX_SSID_LEN);

	memcpy(ssid->ssid, params->ssid, params->ssid_length);
	ssid->ssid_len = params->ssid_length;
	ssid->disabled = 1;
	ssid->key_mgmt = WPA_KEY_MGMT_NONE;

	wpa_s->conf->filter_ssids = 1;
	wpa_s->conf->ap_scan = 1;

	if (params->psk) {
		// TODO: Extend enum wifi_security_type
		if (params->security == 3) {
			ssid->key_mgmt = WPA_KEY_MGMT_SAE;
			str_clear_free(ssid->sae_password);
			ssid->sae_password = dup_binstr(params->psk, params->psk_length);

			if (ssid->sae_password == NULL) {
				wpa_printf(MSG_ERROR, "%s:Failed t copy sae_password\n",
					      __func__);
				return -1;
			}
		} else {
			if (params->security == 2)
				ssid->key_mgmt = WPA_KEY_MGMT_PSK_SHA256;
			else
				ssid->key_mgmt = WPA_KEY_MGMT_PSK;

			str_clear_free(ssid->passphrase);
			ssid->passphrase = dup_binstr(params->psk, params->psk_length);

			if (ssid->passphrase == NULL) {
				wpa_printf(MSG_ERROR, "%s:Failed t copy passphrase\n",
				__func__);
				return -1;
			}
		}

		wpa_config_update_psk(ssid);

		if (pmf)
			ssid->ieee80211w = 1;

	}

	wpa_supplicant_enable_network(wpa_s,
				      ssid);

	wpa_supplicant_select_network(wpa_s,
				      ssid);

	wpa_supp_api_ctrl.dev = dev;
	wpa_supp_api_ctrl.requested_op = CONNECT;
	wpa_supp_api_ctrl.connection_timeout = params->timeout <= 0 ?
			DEFAULT_CONNECTION_TIMEOUT_S: params->timeout;
	/* Cleanup previous spawns */
	k_thread_abort(wpa_supp_api);
	k_thread_start(wpa_supp_api);

	return 0;
}

int zephyr_supp_disconnect(const struct device *dev)
{
	struct wpa_supplicant *wpa_s;

	wpa_s = get_wpa_s_handle(dev);
	if (!wpa_s) {
		return -1;
	}
	wpa_supp_api_ctrl.dev = dev;
	wpa_supp_api_ctrl.requested_op = DISCONNECT;
	wpas_request_disconnection(wpa_s);
	/* Cleanup previous spawns */
	k_thread_abort(wpa_supp_api);
	k_thread_start(wpa_supp_api);
	return 0;
}


static inline int wpas_band_to_zephyr(enum wpa_radio_work_band band)
{
	switch(band) {
		case BAND_2_4_GHZ:
			return WIFI_FREQ_BAND_2_4_GHZ;
		case BAND_5_GHZ:
			return WIFI_FREQ_BAND_5_GHZ;
		default:
			return -1; /* Unknown */
	}
}

static inline int wpas_key_mgmt_to_zephyr(int key_mgmt)
{
	switch(key_mgmt) {
		case WPA_KEY_MGMT_NONE:
			return WIFI_SECURITY_TYPE_NONE;
		case WPA_KEY_MGMT_PSK:
			return WIFI_SECURITY_TYPE_PSK;
		case WPA_KEY_MGMT_PSK_SHA256:
			return WIFI_SECURITY_TYPE_PSK_SHA256;
		case WPA_KEY_MGMT_SAE:
			return WIFI_SECURITY_TYPE_SAE;
		default:
			return -1; /* Unknown */
	}
}


struct wifi_iface_status* zephyr_supp_status(const struct device *dev)
{
	struct wifi_iface_status *status;
	struct wpa_supplicant *wpa_s;
	struct wpa_signal_info si;
	int ret;

	wpa_s = get_wpa_s_handle(dev);
	if (!wpa_s) {
		return NULL;
	}

	status = os_zalloc(sizeof(*status));
	if (!status) {
		wpa_printf(MSG_ERROR, "failed to allocate memory for status\n");
		return NULL;
	}

	status->state = wpa_s->wpa_state;

	if (wpa_s->wpa_state >= WPA_ASSOCIATED) {
		struct wpa_ssid *ssid = wpa_s->current_ssid;
		u8 channel;

		os_memcpy(status->bssid, wpa_s->bssid, WIFI_MAC_ADDR_LEN);
		status->band = wpas_band_to_zephyr(wpas_freq_to_band(wpa_s->assoc_freq));
		status->security = wpas_key_mgmt_to_zephyr(ssid->key_mgmt);
		status->mfp = ssid->ieee80211w; /* Same mapping */
		ieee80211_freq_to_chan(wpa_s->assoc_freq, &channel);
		status->channel = channel;

		if (ssid) {
			u8 *_ssid = ssid->ssid;
			size_t ssid_len = ssid->ssid_len;
			u8 ssid_buf[SSID_MAX_LEN] = {0};

			if (ssid_len == 0) {
				int _res = wpa_drv_get_ssid(wpa_s, ssid_buf);

				if (_res < 0)
					ssid_len = 0;
				else
					ssid_len = _res;
				_ssid = ssid_buf;
			}
			os_memcpy(status->ssid, _ssid, ssid_len);
			status->ssid_len = ssid_len;
			status->iface_mode = ssid->mode;
			/* TODO: Derive this based on association IEs */
			status->link_mode = WIFI_6;
		}
		ret = wpa_drv_signal_poll(wpa_s, &si);
		if (!ret) {
			status->rssi = si.current_signal;
		}
	}

	return status;
}

int zephyr_supp_stats(const struct device *dev, struct net_stats_wifi *zstats)
{
	//struct net_stats_wifi *zstats = NULL;
	struct rpu_op_stats stats;
	const struct wifi_nrf_dev_ops *dev_ops = dev->api;
	int ret = -1;

	ret = dev_ops->off_api.get_stats(dev, &stats);

	if (!ret) {
		zstats->pkts.tx = stats.host.total_tx_pkts;
		zstats->pkts.rx = stats.host.total_rx_pkts;
		goto out;
	}

out:
	return ret;

}
```

## src/zephyr_supp_api.h
```c
/*
 * Copyright (c) 2022 Nordic Semiconductor
 *
 * SPDX-License-Identifier: LicenseRef-Nordic-5-Clause
 *
 */

#ifndef ZEPHYR_SUPP_MGMT_H
#define ZEPHYR_SUPP_MGMT_H

#include <zephyr/net/wifi_mgmt.h>
#include <zephyr/net/net_stats.h>

#define MAX_SSID_LEN 32
#define MAC_ADDR_LEN 6

/**
 * @brief Request a scan
 *
 * @param iface_name: Wi-Fi interface name to use
 * @param scan_result_cb_t: Application specific callback when the scan
 * 			attempt is completed.
 *
 * @return: 0 for OK; -1 for ERROR
 */
int zephyr_supp_scan(const struct device *dev, scan_result_cb_t cb);

/**
 * @brief Request a connection
 *
 * @param iface_name: Wi-Fi interface name to use
 * @param params: Connection details
 *
 * @return: 0 for OK; -1 for ERROR
 */
int zephyr_supp_connect(const struct device *dev,
						struct wifi_connect_req_params *params);
/**
 * @brief Forces station to disconnect and stops any subsequent scan
 *  or connection attempts
 *
 * @param iface_name: Wi-Fi interface name to use
 *
 * @return: 0 for OK; -1 for ERROR
 */
int zephyr_supp_disconnect(const struct device *dev);

/**
 * @brief
 *
 * @param iface_name: Wi-Fi interface name to use
 *
 * @return struct wifi_iface_status for OK; NULL for failure cases. Caller is responsible
 * for freeing the memory of wifi_iface_status
 */
struct wifi_iface_status *(zephyr_supp_status)(const struct device *dev);
#endif /* ZEPHYR_SUPP_MGMT_H */
```
